## boards/st/t2i/Kconfig.t2i
```kconfig
# RTI T2i board
# SPDX-License-Identifier: Apache-2.0

config BOARD_T2I
	select SOC_STM32F205XX
```

## boards/st/t2i/board.yml
```yaml
board:
  name: t2i
  full_name: RTI T2i (STM32F205VET6)
  vendor: st
  socs:
    - name: stm32f205xx
```
